# GPIO3 register map
Registers from a debugger description file.
Registers are 32-bit, access not given, no defined reset value unless marked. A register's access mark holds for its fields unless they carry their own. Addresses are absolute; registers are grouped by the start of their names; lines under a group give offsets from that group; [hi:lo] are bit positions; {n}, {i} and the like mark numbered series; 'fields as' and 'values as' point back to an identical list; <NAME> marks a mode.

## GPIO3
0x5000D000 GPIO3/swporta_dr
  [31:0] port_dr
0x5000D004 GPIO3/swporta_ddr
  [31:0] port_ddr
0x5000D00C GPIO3/swportb_dr
  [31:0] port_dr
0x5000D010 GPIO3/swportb_ddr
  [31:0] port_ddr
0x5000D030 GPIO3/inten
  [31:0] inten
0x5000D034 GPIO3/intmask
  [31:0] intmask
0x5000D038 GPIO3/inttype_level
  [31:0] inttype_levell
0x5000D03C GPIO3/int_polarity
  [31:0] int_polarity
0x5000D040 GPIO3/intstatus ro
  [31:0] intstatus
0x5000D044 GPIO3/raw_intstatus ro
  [31:0] raw_intstatus
0x5000D04C GPIO3/porta_eoi
  [31:0] porta_eoi
0x5000D050 GPIO3/ext_porta ro
  [31:0] ext_port
0x5000D054 GPIO3/ext_portb ro
  [31:0] ext_port
0x5000D060 GPIO3/ls_sync
  [0] ls_sync
0x5000D06C GPIO3/ver_id_code ro
  [31:0] Version
