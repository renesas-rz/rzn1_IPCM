# BGPIO1 register map
Registers from a debugger description file.
Registers are 32-bit, access not given, no defined reset value unless marked. A register's access mark holds for its fields unless they carry their own. Addresses are absolute; registers are grouped by the start of their names; lines under a group give offsets from that group; [hi:lo] are bit positions; {n}, {i} and the like mark numbered series; 'fields as' and 'values as' point back to an identical list; <NAME> marks a mode.

## BGPIO1
0x5000B000 BGPIO1/swporta_dr
  [31:0] port_dr
0x5000B004 BGPIO1/swporta_ddr
  [31:0] port_ddr
0x5000B00C BGPIO1/swportb_dr
  [31:0] port_dr
0x5000B010 BGPIO1/swportb_ddr
  [31:0] port_ddr
0x5000B030 BGPIO1/inten
  [31:0] inten
0x5000B034 BGPIO1/intmask
  [31:0] intmask
0x5000B038 BGPIO1/inttype_level
  [31:0] inttype_levell
0x5000B03C BGPIO1/int_polarity
  [31:0] int_polarity
0x5000B040 BGPIO1/intstatus ro
  [31:0] intstatus
0x5000B044 BGPIO1/raw_intstatus ro
  [31:0] raw_intstatus
0x5000B04C BGPIO1/porta_eoi
  [31:0] porta_eoi
0x5000B050 BGPIO1/ext_porta ro
  [31:0] ext_port
0x5000B054 BGPIO1/ext_portb ro
  [31:0] ext_port
0x5000B060 BGPIO1/ls_sync
  [0] ls_sync
0x5000B06C BGPIO1/ver_id_code ro
  [31:0] Version
