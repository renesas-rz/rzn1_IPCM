# RINACS register map
Registers from a debugger description file.
Registers are 32-bit, access not given, no defined reset value unless marked. A register's access mark holds for its fields unless they carry their own. Addresses are absolute; registers are grouped by the start of their names; lines under a group give offsets from that group; [hi:lo] are bit positions; {n}, {i} and the like mark numbered series; 'fields as' and 'values as' point back to an identical list; <NAME> marks a mode.

## RINACS
0x400F2000 RINACS/MDMNT ro
  [0] BOOT
0x400F2004 RINACS/IDCODE ro
{0x400F2010+4i} RINACS/SCRATCH{i} (i=0..3)
0x400F2100 RINACS/RINSPCMD
  [0] RINSPCMD
0x400F2110 RINACS/RTOSRST
  [0] OSRST
