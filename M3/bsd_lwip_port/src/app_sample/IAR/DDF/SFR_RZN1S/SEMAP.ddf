# SEMAP register map
Registers from a debugger description file.
Registers are 32-bit, access not given, no defined reset value unless marked. A register's access mark holds for its fields unless they carry their own. Addresses are absolute; registers are grouped by the start of their names; lines under a group give offsets from that group; [hi:lo] are bit positions; {n}, {i} and the like mark numbered series; 'fields as' and 'values as' point back to an identical list; <NAME> marks a mode.

## LockCPU1
{0x53000000+0x10*i} LockCPU1_{i} (i=0..63)
  [2:0] LockCPU

## StatusCPU1
{0x53000004+0x10*i} StatusCPU1_{i} ro (i=0..63)
  [2:0] StatusCPU

## LockCPU2
{0x53001000+0x10*i} LockCPU2_{i} (i=0..63)
  [2:0] LockCPU

## StatusCPU2
{0x53001004+0x10*i} StatusCPU2_{i} ro (i=0..63)
  [2:0] StatusCPU

## LockCPU3
{0x53002000+0x10*i} LockCPU3_{i} (i=0..63)
  [2:0] LockCPU

## StatusCPU3
{0x53002004+0x10*i} StatusCPU3_{i} ro (i=0..63)
  [2:0] StatusCPU

## LockCPU4
{0x53003000+0x10*i} LockCPU4_{i} (i=0..63)
  [2:0] LockCPU

## StatusCPU4
{0x53003004+0x10*i} StatusCPU4_{i} ro (i=0..63)
  [2:0] StatusCPU
