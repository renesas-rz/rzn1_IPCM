# BGPIO2 register map
Registers from a debugger description file.
Registers are 32-bit, access not given, no defined reset value unless marked. A register's access mark holds for its fields unless they carry their own. Addresses are absolute; registers are grouped by the start of their names; lines under a group give offsets from that group; [hi:lo] are bit positions; {n}, {i} and the like mark numbered series; 'fields as' and 'values as' point back to an identical list; <NAME> marks a mode.

## BGPIO2
0x5000C000 BGPIO2/swporta_dr
  [31:0] port_dr
0x5000C004 BGPIO2/swporta_ddr
  [31:0] port_ddr
0x5000C00C BGPIO2/swportb_dr
  [31:0] port_dr
0x5000C010 BGPIO2/swportb_ddr
  [31:0] port_ddr
0x5000C030 BGPIO2/inten
  [31:0] inten
0x5000C034 BGPIO2/intmask
  [31:0] intmask
0x5000C038 BGPIO2/inttype_level
  [31:0] inttype_levell
0x5000C03C BGPIO2/int_polarity
  [31:0] int_polarity
0x5000C040 BGPIO2/intstatus ro
  [31:0] intstatus
0x5000C044 BGPIO2/raw_intstatus ro
  [31:0] raw_intstatus
0x5000C04C BGPIO2/porta_eoi
  [31:0] porta_eoi
0x5000C050 BGPIO2/ext_porta ro
  [31:0] ext_port
0x5000C054 BGPIO2/ext_portb ro
  [31:0] ext_port
0x5000C060 BGPIO2/ls_sync
  [0] ls_sync
0x5000C06C BGPIO2/ver_id_code ro
  [31:0] Version
