# BGPIO3 register map
Registers from a debugger description file.
Registers are 32-bit, access not given, no defined reset value unless marked. A register's access mark holds for its fields unless they carry their own. Addresses are absolute; registers are grouped by the start of their names; lines under a group give offsets from that group; [hi:lo] are bit positions; {n}, {i} and the like mark numbered series; 'fields as' and 'values as' point back to an identical list; <NAME> marks a mode.

## BGPIO3
0x5000D000 BGPIO3/swporta_dr
  [31:0] port_dr
0x5000D004 BGPIO3/swporta_ddr
  [31:0] port_ddr
0x5000D00C BGPIO3/swportb_dr
  [31:0] port_dr
0x5000D010 BGPIO3/swportb_ddr
  [31:0] port_ddr
0x5000D030 BGPIO3/inten
  [31:0] inten
0x5000D034 BGPIO3/intmask
  [31:0] intmask
0x5000D038 BGPIO3/inttype_level
  [31:0] inttype_levell
0x5000D03C BGPIO3/int_polarity
  [31:0] int_polarity
0x5000D040 BGPIO3/intstatus ro
  [31:0] intstatus
0x5000D044 BGPIO3/raw_intstatus ro
  [31:0] raw_intstatus
0x5000D04C BGPIO3/porta_eoi
  [31:0] porta_eoi
0x5000D050 BGPIO3/ext_porta ro
  [31:0] ext_port
0x5000D054 BGPIO3/ext_portb ro
  [31:0] ext_port
0x5000D060 BGPIO3/ls_sync
  [0] ls_sync
0x5000D06C BGPIO3/ver_id_code ro
  [31:0] Version
